/* ANA UYGULAMA OVERLAY DOSYASI (app.overlay) */
/ {
    chosen {
        zephyr,can-primary = &fdcan1;
    };
};

&fdcan1 {
    status = "okay";
    bitrate = <500000>;
    bitrate-data = <2000000>;
};
