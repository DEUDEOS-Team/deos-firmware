## CMakeLists.txt
```
cmake_minimum_required(VERSION 3.20.0)

set(DTC_OVERLAY_FILE 
    "${CMAKE_CURRENT_LIST_DIR}/app.overlay"
    "${CMAKE_CURRENT_LIST_DIR}/boards/${BOARD}.overlay"
)

find_package(Zephyr REQUIRED HINTS $ENV{ZEPHYR_BASE})

project(deos_firmware)


target_sources(app PRIVATE
    src/main.cpp
    src/MainApp.cpp
    src/io/LedController.cpp
    src/io/SafetyManager.cpp
    src/io/ImuSensor.cpp
    src/network/NetworkMonitor.cpp
    src/transport/eth_textual.cpp
    src/transport/eth_ros_bridge.cpp
    src/transport/uart_lora.cpp
    ../../lib/deos_core/src/deos_core.c
    ../../lib/deos_core/src/deos_send.c
    ../../lib/deos_core/src/deos_dispatch.c
    ../../lib/deos_core/src/deos_codec.c
    ../../lib/deos_core/src/deos_network.c
    ../../lib/deos_core/src/deos_router.c
    ../../lib/deos_core/src/deos_fault.c
    ../../lib/deos_core/src/deos_subscription.c
    ../../lib/deos_core/src/deos_frame.c
    ../../lib/deos_core/src/deos_registry.c
    ../../lib/deos_transport_can/src/deos_can_transport.c
    ../../lib/deos_transport_can/src/deos_can_codec.c
)

zephyr_include_directories(../../lib/deos_core/include)
zephyr_include_directories(../../lib/deos_protocol/include)
zephyr_include_directories(../../lib/deos_transport_can/include)

# Disable thread-safe statics for C++ to prevent __cxa_guard_* linker errors
target_compile_options(app PRIVATE $<$<COMPILE_LANGUAGE:CXX>:-fno-threadsafe-statics>)
```

## prj.conf
```kconfig
# ============================================================
# Zephyr Project Configuration
# ============================================================

# Console / printk
CONFIG_PRINTK=y

# Assertions
CONFIG_ASSERT=y

# Logging
CONFIG_LOG=y
CONFIG_LOG_DEFAULT_LEVEL=3
CONFIG_CAN_LOG_LEVEL_DBG=y

# Main thread stack
CONFIG_MAIN_STACK_SIZE=4096
CONFIG_THREAD_NAME=y

# ------------------------------------------------------------
# Add project-specific configuration below
# ------------------------------------------------------------

# ---------------------------------------------------------
# DEOS Core Prototype
# ---------------------------------------------------------

CONFIG_LOG=y
CONFIG_LOG_DEFAULT_LEVEL=3

# CAN desteği
CONFIG_CAN=y
CONFIG_CAN_FD_MODE=y

# ---------------------------------------------------------
# DEOS Core Configuration (Optional overrides)
# ---------------------------------------------------------
# CONFIG_DEOS_MAX_LOCAL_NODES=4
# CONFIG_DEOS_MAX_FAULT_RECORDS=32
# CONFIG_DEOS_MAX_HANDLERS=32
# CONFIG_DEOS_RX_QUEUE_SIZE=16
# CONFIG_DEOS_RX_THREAD_STACK_SIZE=1024
# CONFIG_DEOS_RX_THREAD_PRIORITY=5

# ---------------------------------------------------------
# LoRa UART & GPIO settings
# ---------------------------------------------------------
CONFIG_SERIAL=y
CONFIG_UART_INTERRUPT_DRIVEN=y
CONFIG_GPIO=y

# ---------------------------------------------------------
# CRC Support for LoRa
# ---------------------------------------------------------
CONFIG_CRC=y

# ---------------------------------------------------------
# Networking / Ethernet / TCP Sockets
# ---------------------------------------------------------
CONFIG_NETWORKING=y
CONFIG_NET_IPV4=y
CONFIG_NET_TCP=y
CONFIG_NET_UDP=y
CONFIG_NET_SOCKETS=y
# Maksimum bağlantı ve soket ayarları
CONFIG_NET_MAX_CONN=4
CONFIG_NET_MAX_CONTEXTS=4

# İsteğe bağlı Statik IP ayarı (Eğer DHCP yoksa)
# RPi tarafı ile aynı ağda (örn: 192.168.1.x) olmalıdır
CONFIG_NET_CONFIG_SETTINGS=y
CONFIG_NET_CONFIG_MY_IPV4_ADDR="192.168.1.10"
CONFIG_NET_CONFIG_PEER_IPV4_ADDR="192.168.1.1"

# Ethernet kablosu takılı değilse veya link gecikirse Zephyr'in bootta beklemesini engelle
CONFIG_NET_CONFIG_INIT_TIMEOUT=0
# ---------------------------------------------------------
# C++ Support
# ---------------------------------------------------------
CONFIG_CPP=y
CONFIG_STD_CPP17=y

# ---------------------------------------------------------
# ROS 2 UDP Bridge Support
# ---------------------------------------------------------
CONFIG_PICOLIBC=n
CONFIG_NEWLIB_LIBC=y

CONFIG_POSIX_API=y
```

## app.overlay
```dts
/*
 * ==============================================================================
 * ANA UYGULAMA OVERLAY DOSYASI (app.overlay)
 * ==============================================================================
 * Amacı: Bu dosya, uygulamanın donanımdan bağımsız "iskelet" yapısını kurar.
 * Hangi karta derlenirse derlensin her zaman geçerli olan ortak ayarları içerir.
 * Fiziksel pin atamaları BURADA YAPILMAZ! Pin atamaları 'boards/' klasöründeki
 * karta özel overlay dosyalarında yapılır.
 * ==============================================================================
 */

/ {
    chosen {
        zephyr,can-primary = &fdcan1;
    };
};

/* Enable Primary CAN (FDCAN1) */
&fdcan1 {
    status = "okay";
    bitrate = <500000>;
    bitrate-data = <2000000>;
};
```

## src/MainApp.cpp
```c
#include "MainApp.hpp"
#include "transport/eth_textual.hpp"
#include "transport/eth_ros_bridge.hpp"
#include "transport/uart_lora.hpp"
#include <deos/deos_can.h>
#include "io/ImuSensor.hpp"
#include <zephyr/logging/log.h>

LOG_MODULE_REGISTER(main_node_app, LOG_LEVEL_INF);

MainApp& MainApp::getInstance() {
    static MainApp instance;
    return instance;
}

static const char* state_to_str(deos_state_t s) {
    switch(s) {
        case DEOS_STATE_INIT: return "INIT (0x00)";
        case DEOS_STATE_STANDBY: return "STANDBY (0x01)";
        case DEOS_STATE_READY: return "READY (0x02)";
        case DEOS_STATE_ACTIVE: return "ACTIVE (0x03)";
        case DEOS_STATE_CALIBRATING: return "CALIBRATING (0x04)";
        case DEOS_STATE_SAFE: return "SAFE (0x05)";
        case DEOS_STATE_FAULT: return "FAULT (0x06)";
        default: return "UNKNOWN";
    }
}

extern "C" {
    int heartbeat_rx_callback(const deos_message_t *msg, void *user_data) {
        MainApp& app = MainApp::getInstance();
        
        deos_state_t reported_state = DEOS_STATE_UNKNOWN;
        if (msg->payload_len == sizeof(struct deos_heartbeat_payload)) {
            const struct deos_heartbeat_payload *pl = (const struct deos_heartbeat_payload *)msg->payload;
            reported_state = (deos_state_t)pl->current_state;
        }
        
        app.network_monitor.update_heartbeat(msg->source, reported_state, app.get_state());
        return 0;
    }

    int set_state_rx_callback(const deos_message_t *msg, void *user_data) {
        MainApp& app = MainApp::getInstance();
        
        /* Eğer bu mesaj Main STM32'nin kendi yayınladığı genel durum broadcast'i ise,
         * döngü (loopback) oluşturup gereksiz yanıt basmamak için işlemiyoruz. */
        if (msg->source == DEOS_NODE_MAIN_STM32) {
            return 0;
        }

        if (msg->payload_len == 1) {
            deos_state_t req_state = (deos_state_t)msg->payload[0];
            LOG_INF("Received SET_STATE command from %s (0x%02X): requesting state %s", 
                    deos_node_name(msg->source), msg->source, state_to_str(req_state));
            app.set_state(req_state);
            deos_send_response(msg, DEOS_RESULT_SUCCESS, NULL, 0);
        } else {
            LOG_WRN("Invalid SET_STATE payload length: %d", msg->payload_len);
            deos_send_response(msg, DEOS_RESULT_INVALID_PARAMETER, NULL, 0);
        }
        return 0;
    }

    int get_state_rx_callback(const deos_message_t *msg, void *user_data) {
        MainApp& app = MainApp::getInstance();
        deos_state_t current = app.get_state();
        LOG_INF("Received GET_STATE request from %s (0x%02X), replying with state %s", 
                deos_node_name(msg->source), msg->source, state_to_str(current));
        uint8_t state_byte = (uint8_t)current;
        deos_send_response(msg, DEOS_RESULT_SUCCESS, &state_byte, sizeof(state_byte));
        return 0;
    }

    int lighting_command_rx_callback(const deos_message_t *msg, void *user_data) {
        MainApp& app = MainApp::getInstance();

        if (msg->payload_len >= 1) {
            uint8_t light_id = msg->payload[0];
            bool turn_on = (msg->command == DEOS_CMD_LIGHTING_TURN_ON);

            LOG_INF("Lighting Cmd RX from %s (0x%02X): Light ID %d -> %s",
                    deos_node_name(msg->source), msg->source, light_id, turn_on ? "ON" : "OFF");

            int ret = app.led_controller.set_light(light_id, turn_on);
            if (ret == 0) {
                struct deos_lighting_status_payload status = app.led_controller.get_status();
                deos_send_response(msg, DEOS_RESULT_SUCCESS, &status, sizeof(status));
            } else {
                deos_send_response(msg, DEOS_RESULT_INVALID_PARAMETER, NULL, 0);
            }
        } else {
            LOG_WRN("Invalid LIGHTING command payload length: %d", msg->payload_len);
            deos_send_response(msg, DEOS_RESULT_INVALID_PARAMETER, NULL, 0);
        }
        return 0;
    }

    int lighting_get_status_rx_callback(const deos_message_t *msg, void *user_data) {
        MainApp& app = MainApp::getInstance();
        struct deos_lighting_status_payload status = app.led_controller.get_status();
        deos_send_response(msg, DEOS_RESULT_SUCCESS, &status, sizeof(status));
        return 0;
    }

    deos_transport_t c_routing_policy(deos_node_id_t destination) {
        if (destination == DEOS_NODE_MAIN_STM32) {
            return DEOS_TRANSPORT_LOCAL;
        } else if (destination == DEOS_NODE_GLOBAL_BROADCAST) {
            return DEOS_TRANSPORT_BROADCAST_ALL;
        } else if (destination == DEOS_NODE_CAN_BROADCAST) {
            return DEOS_TRANSPORT_CAN_FD;
        } else if (destination == DEOS_NODE_GROUND_CONTROL) {
            return DEOS_TRANSPORT_UART_LORA;
        } else if (destination == DEOS_NODE_ROS_BRIDGE) {
            return DEOS_TRANSPORT_ETH_ROS_BRIDGE;
        } else if (destination == DEOS_NODE_DIAG_TOOL) {
            return DEOS_TRANSPORT_ETH_TEXTUAL;
        } else if (destination >= DEOS_NODE_TRACTION && destination <= DEOS_NODE_BMS_GATEWAY) {
            return DEOS_TRANSPORT_CAN_FD;
        }
        return DEOS_TRANSPORT_UNKNOWN;
    }
}

int MainApp::init() {
    int ret = led_controller.init();
    if (ret != 0) return ret;

    ret = safety_manager.init();
    if (ret != 0) return ret;

    struct deos_config config = {
        .node_id = DEOS_NODE_MAIN_STM32,
        .router_enabled = true,
        .hosted_nodes_enabled = true
    };

    ret = deos_init(&config);
    if (ret != 0) {
        LOG_ERR("DEOS init failed: %d", ret);
        return ret;
    }

    deos_router_set_lookup_fn(c_routing_policy);

    /* Düğüm kimlik ve yetenek metaverisini kaydet (GET_NODE_INFO) */
    uint32_t supported_services = (1U << DEOS_SERVICE_SYSTEM) | (1U << DEOS_SERVICE_LIGHTING);
    deos_set_node_info(DEOS_HW_TYPE_STM32H5, 1, 0, 0, 0, supported_services);
    
    /* DEOS çekirdeğine Heartbeat paketlerini nereye düşüreceğini söylüyoruz */
    deos_register_handler(DEOS_CLASS_NETWORK, DEOS_SERVICE_SYSTEM, DEOS_CMD_SYSTEM_HEARTBEAT, heartbeat_rx_callback, NULL);

    /* SET_STATE komutunu (Cmd: 0x02, Class: COMMAND) dinle */
    deos_register_handler(DEOS_CLASS_COMMAND, DEOS_SERVICE_SYSTEM, DEOS_CMD_SYSTEM_SET_STATE, set_state_rx_callback, NULL);
    deos_register_handler(DEOS_CLASS_REQUEST, DEOS_SERVICE_SYSTEM, DEOS_CMD_SYSTEM_SET_STATE, set_state_rx_callback, NULL);

    /* GET_STATE isteğini (Cmd: 0x01, Class: REQUEST) dinle */
    deos_register_handler(DEOS_CLASS_REQUEST, DEOS_SERVICE_SYSTEM, DEOS_CMD_SYSTEM_GET_STATE, get_state_rx_callback, NULL);

    /* LIGHTING (0x08) komut ve durum sorgularını dinle */
    deos_register_handler(DEOS_CLASS_COMMAND, DEOS_SERVICE_LIGHTING, DEOS_CMD_LIGHTING_TURN_ON, lighting_command_rx_callback, NULL);
    deos_register_handler(DEOS_CLASS_COMMAND, DEOS_SERVICE_LIGHTING, DEOS_CMD_LIGHTING_TURN_OFF, lighting_command_rx_callback, NULL);
    deos_register_handler(DEOS_CLASS_REQUEST, DEOS_SERVICE_LIGHTING, DEOS_CMD_LIGHTING_GET_STATUS, lighting_get_status_rx_callback, NULL);

    ret = deos_can_transport_init(NULL);
    if (ret != 0) {
        LOG_ERR("CAN transport init failed: %d", ret);
        return ret;
    }
    EthTextual::getInstance().init();
    EthRosBridge::getInstance().init();
    UartLora::getInstance().init();
    ImuSensor::getInstance().init();

    return 0;
}

deos_state_t MainApp::get_state() const {
    return (deos_state_t)atomic_get(&current_state);
}

void MainApp::set_state(deos_state_t new_state) {
    atomic_val_t previous_state = atomic_set(&current_state, (atomic_val_t)new_state);
    if ((deos_state_t)previous_state == new_state) return;

    /* Apply local safety effects before any transport operation. The LED
     * controller serializes GPIO access across the main and RX threads. */
    led_controller.update(new_state, k_uptime_get_32());
    LOG_INF("System State changed to: %s", state_to_str(new_state));

    /* Durum değiştiğinde ağdaki tüm nodlara bildir (Broadcast) */
    deos_priority_t prio = (new_state == DEOS_STATE_SAFE || new_state == DEOS_STATE_FAULT) 
                            ? DEOS_PRIO_EMERGENCY : DEOS_PRIO_CONTROL;

    int ret = deos_send(DEOS_NODE_GLOBAL_BROADCAST, prio, DEOS_CLASS_COMMAND, DEOS_SERVICE_SYSTEM,
                        DEOS_CMD_SYSTEM_SET_STATE, &new_state, sizeof(new_state));
    if (ret != 0) {
        LOG_WRN("Failed to broadcast state %s: %d", state_to_str(new_state), ret);
    }
}

void MainApp::run() {
    deos_start();

    LOG_INF("Main System Controller (Brain) loop started.");

    /* Kritik düğümlerin (BMS Main, BMS Aux, Traction, Brake, Steering) Heartbeat akışına abone ol */
    network_monitor.subscribe_heartbeats();

    /* Sistemi hazır (STANDBY) moduna geçir */
    set_state(DEOS_STATE_STANDBY);
    
    uint32_t ms_counter = 0;
    bool last_estop_state = safety_manager.is_estop_triggered();

    while (1) {
        bool estop_pressed = safety_manager.is_estop_triggered();

        /* --- DONANIMSAL KESME / GÜVENLİK KONTROLÜ (EDGE DETECTION) --- */
        if (estop_pressed && !last_estop_state) {
            LOG_ERR("!!! EMERGENCY STOP TRIGGERED !!!");
            set_state(DEOS_STATE_SAFE);
        } else if (!estop_pressed && last_estop_state) {
            LOG_INF("E-STOP Released.");
            set_state(DEOS_STATE_STANDBY);
        }
        
        last_estop_state = estop_pressed;

        /* --- NETWORK (NODE) WATCHDOG --- */
        network_monitor.check_watchdog(*this);

        /* --- STATE MACHINE (DURUM MAKİNESİ) Görselleri --- */
        led_controller.update(get_state(), ms_counter);

        ms_counter += 10;
        k_sleep(K_MSEC(10));
    }
}
```

## src/MainApp.hpp
```c
#pragma once

#include <deos/deos.h>
#include <zephyr/sys/atomic.h>
#include "io/LedController.hpp"
#include "io/SafetyManager.hpp"
#include "network/NetworkMonitor.hpp"

class MainApp {
public:
    static MainApp& getInstance();
    
    int init();
    void run();

    deos_state_t get_state() const;
    void set_state(deos_state_t new_state);
    
    NetworkMonitor network_monitor;
    LedController led_controller;
    SafetyManager safety_manager;

private:
    MainApp() = default;
    ~MainApp() = default;

    atomic_t current_state = ATOMIC_INIT(DEOS_STATE_INIT);

    // Non-copyable
    MainApp(const MainApp&) = delete;
    MainApp& operator=(const MainApp&) = delete;
};
```
