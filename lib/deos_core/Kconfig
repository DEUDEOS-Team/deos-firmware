## lib/deos_core/Kconfig
```kconfig
menu "DEOS Core Protocol Stack"

config DEOS_MAX_LOCAL_NODES
    int "Maximum number of local logical nodes"
    default 4
    help
      Maximum number of hosted local logical nodes allowed on this MCU.

config DEOS_MAX_FAULT_RECORDS
    int "Maximum number of active fault records per node"
    default 32
    help
      Maximum capacity of the fault table for each logical node.

config DEOS_MAX_HANDLERS
    int "Maximum number of message handlers"
    default 32
    help
      Maximum number of registered message handlers across all local nodes.

config DEOS_MAX_SUBSCRIPTIONS
    int "Maximum number of telemetry subscriptions"
    default 8
    help
      Maximum capacity of the active telemetry subscription table.

config DEOS_RX_QUEUE_SIZE
    int "RX Message Queue Size"
    default 16
    help
      Size of the queue for incoming CAN frames before dropping them.

config DEOS_RX_THREAD_STACK_SIZE
    int "RX Thread Stack Size"
    default 1024
    help
      Stack size of the background thread processing received CAN frames.

config DEOS_RX_THREAD_PRIORITY
    int "RX Thread Priority"
    default 5
    help
      Zephyr thread priority for the DEOS RX thread.

endmenu
```
